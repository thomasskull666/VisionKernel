## Kernel/drivers/video/samsung/b/Kernel/drivers/video/samsung/Kconfig.rej
```kconfig
--- a/Kernel/drivers/video/samsung/Kconfig
+++ b/Kernel/drivers/video/samsung/Kconfig
@@ -87,6 +87,13 @@
         ---help---
           This enables support for Samsung TL2796 WVGA LCD panel
 
+config VOODOO_COLOR_GAMMA_22_ONLY
+	bool "Voodoo color: improve gamma in videos"
+	depends on FB_S3C_TL2796
+	default y
+	---help---
+	  This enables Voodoo color gamma curve optimization in videos
+
 config FB_S3C_HT101HD1
 	bool "HT101HD1"
 	depends on MACH_SMDKV210
@@ -116,6 +123,20 @@
 	---help---
 		  This option enables to control mDNIe tuning for backlights.
 
+config VOODOO_MDNIE
+	bool "Voodoo color: mDNIe sharpness and color enhancements"
+	depends on FB_S3C_MDNIE
+	default y
+	---help---
+	  This enables Voodoo color mDNIe tweaks
+
+config VOODOO_MDNIE_VIDEOS_ALT_PRESETS
+	bool "Also replace Warm & Cold Video presets by Boost and Soft"
+	depends on VOODOO_MDNIE
+	default y
+	---help---
+	  This enables Voodoo color mDNIe useful alternative presets used by Samsung video player
+
 config FB_S3C_LVDS
 	bool "LVDS"
 	depends on FB_S3C && (ARCH_S5PV210)
@@ -132,14 +153,6 @@
 	---help---
 	  This enables support for Samsung AMS701KA LCD panel
 
-config FB_S3C_MDNIE
-	bool "Samsung MDNIE"
-	depends on FB_S3C
-	depends on FB_S3C && (ARCH_S5PV210)
-	default "0"
-	---help---
-	  This enables support for Samsung MDNIE feature
-
 config FB_S3C_TL2796_ACL
 	bool "Samsung TL2796(ACL)"
 	depends on FB_S3C_TL2796
```
